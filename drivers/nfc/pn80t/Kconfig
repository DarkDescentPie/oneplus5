## drivers/nfc/pn80t/Kconfig
```kconfig
config NFC_PN80T
	tristate "NXP PN80T eSE Driver"
	depends on I2C
	depends on SPI
	depends on NFC_PN5XX
```

## drivers/oneplus/Kconfig
```kconfig
config OEM_DEBUG_SUPPORT
	bool "OEM Debug Support"
	default y

config OEM_TRACE_SUPPORT
	default y
	depends on OEM_DEBUG_SUPPORT
	bool "OEM debug function, enable it will register the device, which under /dev/otracer."
```
